/* Copyright (c) 2012-2013, The Linux Foundation. All rights reserved.
 *
 * This program is free software; you can redistribute it and/or modify
 * it under the terms of the GNU General Public License version 2 and
 * only version 2 as published by the Free Software Foundation.
 *
 * This program is distributed in the hope that it will be useful,
 * but WITHOUT ANY WARRANTY; without even the implied warranty of
 * MERCHANTABILITY or FITNESS FOR A PARTICULAR PURPOSE.  See the
 * GNU General Public License for more details.
 */

/include/ "msm8974-14001-common.dtsi"
/include/ "msm8974-14001-camera.dtsi"
/include/ "msm8974-14001-input.dtsi"
/include/ "msm8974-14001-usb.dtsi"
/include/ "msm8974-14001-misc.dtsi"
/include/ "msm8974-14001-pm.dtsi"
/include/ "msm8974-14001-nfc.dtsi"
/include/ "msm8974-14001-regulator.dtsi"
/include/ "msm8974-oppo-sound.dtsi"
/include/ "msm8974-14001-sound.dtsi"
/include/ "msm8974-14001-leds.dtsi"

&i2c_1 {
	status = "ok";
};

&spi_0 {
	status = "disabled";
};

&spi_7 {
	status = "disabled";
};

&pm8941_boost {
	regulator-min-microvolt = <4500000>;
	regulator-max-microvolt = <4500000>;
};
